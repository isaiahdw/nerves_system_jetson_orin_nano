## package/nvbootctrl/Config.in
```kconfig
config BR2_PACKAGE_NVBOOTCTRL
	bool "nvbootctrl"
	help
	  NVIDIA's boot-chain control tool for Jetson (t234), extracted
	  from the nvidia-l4t-tools Debian package. Marks boots
	  successful so the UEFI firmware's per-boot retry counters
	  reset - without this, three boots without a "verify" latch
	  "OS chain A status" to Unbootable and the firmware stops
	  attempting Direct Boot (docs/provisioning.md). Also used for
	  rootfs A/B slot control once firmware redundancy is enabled.

	  Needs /etc/nv_boot_control.conf (shipped in rootfs_overlay,
	  values mirrored from this board's TegraPlatformSpec UEFI
	  variable) and efivarfs mounted.

	  https://repo.download.nvidia.com/jetson/
```

## package/nvidia-oot/Config.in
```kconfig
config BR2_PACKAGE_NVIDIA_OOT
	bool "nvidia-oot kernel modules"
	depends on BR2_LINUX_KERNEL
	help
	  NVIDIA's out-of-tree kernel modules for Jetson (nvidia-oot
	  core + nvgpu + hwpm) from the L4T r39.2 public_sources
	  release, built against the system kernel. Provides the GPU
	  device (/dev/nvgpu/igpu0) that the CUDA userland drives.

	  Display modules are not built (headless system).

	  EXPERIMENTAL: see docs/m4-cuda.md; the module set and any
	  in-tree driver replacements are still being validated.
```

## package/tegra-libs/Config.in
```kconfig
config BR2_PACKAGE_TEGRA_LIBS
	bool "tegra GPU userspace libraries"
	help
	  NVIDIA's proprietary Tegra userspace for the GPU compute path,
	  extracted from the L4T r39.2 BSP tarball's embedded Debian
	  packages: nvidia-l4t-core (the libnvrm_* resource-manager
	  stack), nvidia-l4t-cuda (CUDA driver-level libraries) and
	  nvidia-l4t-cuda-nvgpu (the libcuda variant matching the nvgpu
	  kernel driver this system uses - not the openrm variant).

	  First cut installs the debs' full library payload; prune with
	  real usage data (docs/m4-cuda.md).
```

## package/tensorrt-runtime/Config.in
```kconfig
config BR2_PACKAGE_TENSORRT_RUNTIME
	bool "tensorrt runtime"
	select BR2_PACKAGE_TEGRA_LIBS
	help
	  TensorRT 10.16 runtime libraries, the ONNX parser, trtexec, and
	  the CUDA runtime (cudart 13.2) from NVIDIA's JetPack 7.2 apt
	  feed. TensorRT 10 needs no cuDNN. trtexec is the GPU smoke
	  test: it can build and run an engine from an ONNX model with
	  nothing else installed (docs/m4-cuda.md).
```
